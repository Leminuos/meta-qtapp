## conf/distro/smartfarm.conf
```bitbake
require conf/distro/poky.conf

DISTRO = "smartfarm"
DISTRO_NAME = "SmartFarm Distro"
DISTRO_VERSION = "1.0"

DISTRO_FEATURES:append = " systemd"
VIRTUAL-RUNTIME_init_manager = "systemd"
DISTRO_FEATURES_BACKFILL_CONSIDERED += "sysvinit"
VIRTUAL_RUNTIME_initscripts = "symtemd-compat-units"

PACKAGECONFIG_DISTRO:pn-qtbase = " linuxfb tslib fontconfig"

TOOLCHAIN_TARGET_TASK:append = " libgpiod-dev \
                                 mosquitto-dev "
```

## conf/layer.conf
```bitbake
# We have a conf and classes directory, add to BBPATH
BBPATH .= ":${LAYERDIR}"

# We have recipes-* directories, add to BBFILES
BBFILES += "${LAYERDIR}/recipes-*/*/*.bb \
            ${LAYERDIR}/recipes-*/*/*.bbappend"

BBFILE_COLLECTIONS += "meta-qtapp"
BBFILE_PATTERN_meta-qtapp = "^${LAYERDIR}/"
BBFILE_PRIORITY_meta-qtapp = "6"

LAYERDEPENDS_meta-qtapp = "core"
LAYERSERIES_COMPAT_meta-qtapp = "kirkstone"
```
